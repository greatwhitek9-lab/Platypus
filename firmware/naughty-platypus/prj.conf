## CMakeLists.txt
```
cmake_minimum_required(VERSION 3.20.0)

find_package(Zephyr REQUIRED HINTS $ENV{ZEPHYR_BASE})
project(naughty_platypus)

target_sources(app PRIVATE
    src/main.c
    src/tool_registry.c
    src/restricted_stubs.c
    src/passive_survey.c
)
```

## Kconfig
```
menu "Naughty Platypus Ubertooth-Style Lab Suite"

config NP_ENABLE_PASSIVE_SURVEY
    bool "Enable passive BLE advertisement survey"
    default y
    help
      Enables passive BLE advertisement observation, RSSI logging, and
      advertisement metadata parsing.

config NP_ENABLE_ADV_ANALYZER
    bool "Enable BLE advertisement analyzer"
    default y
    help
      Enables BLE advertisement metadata parsing for names, flags, TX power,
      manufacturer-data previews, and service-data previews.

config NP_ENABLE_RSSI_SURVEY
    bool "Enable RSSI survey counters"
    default y
    help
      Enables signal survey counters for lab positioning, antenna, and enclosure tests.

config NP_ENABLE_CHANNEL_SURVEY_PLACEHOLDER
    bool "Enable channel survey safe lab status"
    default y
    help
      Placeholder only. Standard Zephyr BLE observer mode is not a raw Ubertooth
      channel-hop sniffer.

config NP_ENABLE_BLE_CONNECTION_FOLLOW_PLACEHOLDER
    bool "Enable BLE connection-follow safe lab status"
    default y
    help
      Placeholder only. No connection-following or private-payload capture logic
      is included.

config NP_ENABLE_BLE_GATT_MUTATION_PLACEHOLDER
    bool "Enable GATT read-only audit status"
    default y
    help
      Placeholder only. No GATT fuzzing, mutation, or unauthorized write logic
      is included.

config NP_ENABLE_BLE_PAIRING_LAB_PLACEHOLDER
    bool "Enable pairing policy status check"
    default y
    help
      Placeholder only. No forced pairing, coercion, or credential capture logic
      is included.

config NP_ENABLE_BLE_ADV_TX_PLACEHOLDER
    bool "Enable local advertising self-test status"
    default y
    help
      Placeholder only. No spoofing, impersonation, flooding, or deceptive
      advertising behavior is included.

config NP_ENABLE_BLE_STABILITY_STRESS_PLACEHOLDER
    bool "Enable local firmware health self-test"
    default y
    help
      Placeholder only. No flooding, denial-of-service, or disruption logic is
      included.

config NP_ENABLE_CLASSIC_BT_PLACEHOLDER
    bool "Enable Bluetooth Classic placeholder"
    default n
    help
      Placeholder only. The nRF52840 is BLE-focused and does not provide a
      Bluetooth Classic BR/EDR sniffer equivalent to Ubertooth.

endmenu

source "Kconfig.zephyr"
```

## prj.conf
```kconfig
# Naughty Platypus: Ubertooth-style BLE lab suite for Heltec T114 / HT-n5262 / nRF52840.
#
# This build is NOT the normal Platypus BlueZ HCI firmware.
# It appears as a USB CDC ACM serial lab instrument and streams JSON events.
#
# Safe/default tools are enabled.
# Higher-risk tools are declared but intentionally disabled / stub-only.

CONFIG_BT=y
CONFIG_BT_OBSERVER=y
CONFIG_BT_DEVICE_NAME="Naughty Platypus"
CONFIG_BT_DEVICE_APPEARANCE=0

CONFIG_BT_BUF_EVT_RX_SIZE=255
CONFIG_BT_BUF_EVT_RX_COUNT=16

CONFIG_MAIN_STACK_SIZE=4096
CONFIG_SYSTEM_WORKQUEUE_STACK_SIZE=2048


CONFIG_SERIAL=y
CONFIG_CONSOLE=y
CONFIG_UART_CONSOLE=y
CONFIG_PRINTK=y

CONFIG_SHELL=y
CONFIG_SHELL_BACKEND_SERIAL=y
CONFIG_SHELL_PROMPT_UART="naughty-platypus> "

CONFIG_LOG=y
CONFIG_LOG_MODE_IMMEDIATE=y
CONFIG_LOG_DEFAULT_LEVEL=2

# Safe/default lab tools.
CONFIG_NP_ENABLE_PASSIVE_SURVEY=y
CONFIG_NP_ENABLE_ADV_ANALYZER=y
CONFIG_NP_ENABLE_RSSI_SURVEY=y

# Restricted placeholders. These intentionally remain disabled.
# Purple activation docs are in docs/manual-activation-map.html.
CONFIG_NP_ENABLE_CHANNEL_SURVEY_PLACEHOLDER=y
CONFIG_NP_ENABLE_BLE_CONNECTION_FOLLOW_PLACEHOLDER=y
CONFIG_NP_ENABLE_BLE_GATT_MUTATION_PLACEHOLDER=y
CONFIG_NP_ENABLE_BLE_PAIRING_LAB_PLACEHOLDER=y
CONFIG_NP_ENABLE_BLE_ADV_TX_PLACEHOLDER=y
CONFIG_NP_ENABLE_BLE_STABILITY_STRESS_PLACEHOLDER=y
# CONFIG_NP_ENABLE_CLASSIC_BT_PLACEHOLDER is not set
CONFIG_USB_DEVICE_STACK_NEXT=y
CONFIG_CDC_ACM_SERIAL_INITIALIZE_AT_BOOT=y
CONFIG_STDOUT_CONSOLE=y
CONFIG_UART_LINE_CTRL=y
```

## app.overlay
```dts
/ {
	chosen {
		zephyr,console = &board_cdc_acm_uart;
		zephyr,shell-uart = &board_cdc_acm_uart;
		zephyr,uart-mcumgr = &board_cdc_acm_uart;
		zephyr,bt-mon-uart = &board_cdc_acm_uart;
		zephyr,bt-c2h-uart = &board_cdc_acm_uart;
	};
};
```

## src/main.c
```c
#include <zephyr/drivers/uart.h>
#include <zephyr/devicetree.h>
#include <zephyr/device.h>
#include <errno.h>
#include <stdio.h>

#include <zephyr/kernel.h>
#include <zephyr/sys/printk.h>
#include <zephyr/shell/shell.h>
#include <zephyr/bluetooth/bluetooth.h>

#if defined(CONFIG_USB_DEVICE_STACK)
#include <zephyr/usb/usb_device.h>
#endif

#include "passive_survey.h"
#include "tool_registry.h"

#define NP_FIRMWARE_BUILD "ble_active_default_v5"

static bool bt_ready;

static int cmd_scan_on(const struct shell *sh, size_t argc, char **argv)
{
    ARG_UNUSED(argc);
    ARG_UNUSED(argv);

    int err = np_passive_survey_start();

    if (err) {
        shell_error(sh, "scan_on failed: %d", err);
        return err;
    }

    shell_print(sh, "BLE survey started");
    return 0;
}

static int cmd_scan_off(const struct shell *sh, size_t argc, char **argv)
{
    ARG_UNUSED(argc);
    ARG_UNUSED(argv);

    int err = np_passive_survey_stop();

    if (err) {
        shell_error(sh, "scan_off failed: %d", err);
        return err;
    }

    shell_print(sh, "BLE survey stopped");
    return 0;
}

static int cmd_status(const struct shell *sh, size_t argc, char **argv)
{
    ARG_UNUSED(argc);
    ARG_UNUSED(argv);

    shell_print(sh, "bt_ready=%s survey_running=%s",
                bt_ready ? "yes" : "no",
                np_passive_survey_is_running() ? "yes" : "no");

    return np_passive_survey_status();
}

static int cmd_reset_stats(const struct shell *sh, size_t argc, char **argv)
{
    ARG_UNUSED(argc);
    ARG_UNUSED(argv);

    shell_print(sh, "survey counters reset");
    return np_passive_survey_reset();
}

static int cmd_tools_list(const struct shell *sh, size_t argc, char **argv)
{
    ARG_UNUSED(argc);
    ARG_UNUSED(argv);

    uint32_t count = 0;
    const struct np_tool *tools = np_tools_get(&count);

    for (uint32_t i = 0; i < count; i++) {
        shell_print(sh,
                    "%s | enabled=%s | risk=%s | status=%s | %s",
                    tools[i].id,
                    tools[i].enabled ? "true" : "false",
                    np_risk_to_str(tools[i].risk),
                    np_status_to_str(tools[i].status),
                    tools[i].description);
    }

    return 0;
}

static int cmd_tools_run(const struct shell *sh, size_t argc, char **argv)
{
    if (argc < 2) {
        shell_error(sh, "usage: np tools_run <tool_id>");
        return -EINVAL;
    }

    int err = np_tool_run_by_id(argv[1]);

    if (err == -EPERM) {
        shell_error(sh, "tool disabled by build config: %s", argv[1]);
    } else if (err == -ENOTSUP) {
        shell_error(sh, "tool is stub-only / not implemented: %s", argv[1]);
    } else if (err == -ENOENT) {
        shell_error(sh, "unknown tool: %s", argv[1]);
    } else if (err) {
        shell_error(sh, "tool failed: %d", err);
    }

    return err;
}

SHELL_STATIC_SUBCMD_SET_CREATE(sub_np,
    SHELL_CMD(scan_on, NULL, "Start BLE advertisement survey", cmd_scan_on),
    SHELL_CMD(scan_off, NULL, "Stop BLE advertisement survey", cmd_scan_off),
    SHELL_CMD(status, NULL, "Show survey status and counters", cmd_status),
    SHELL_CMD(reset_stats, NULL, "Reset survey counters", cmd_reset_stats),
    SHELL_CMD(tools_list, NULL, "List safe and restricted tool registry", cmd_tools_list),
    SHELL_CMD(tools_run, NULL, "Run enabled tool by ID", cmd_tools_run),
    SHELL_SUBCMD_SET_END
);

SHELL_CMD_REGISTER(np, &sub_np, "Naughty Platypus lab commands", NULL);

static void np_cdc_write(const char *s)
{
#if DT_NODE_HAS_STATUS(DT_NODELABEL(board_cdc_acm_uart), okay)
    const struct device *dev = DEVICE_DT_GET(DT_NODELABEL(board_cdc_acm_uart));

    if (!device_is_ready(dev) || s == NULL) {
        return;
    }

#if defined(CONFIG_UART_LINE_CTRL)
    uint32_t dtr = 0;

    for (int i = 0; i < 40; i++) {
        if (uart_line_ctrl_get(dev, UART_LINE_CTRL_DTR, &dtr) == 0 && dtr) {
            break;
        }
        k_sleep(K_MSEC(50));
    }
#endif

    while (*s) {
        uart_poll_out(dev, (unsigned char)*s++);
    }
#else
    ARG_UNUSED(s);
#endif
}

static void np_cdc_write_u32(const char *prefix, uint32_t value, const char *suffix)
{
    char buf[128];

    snprintk(buf, sizeof(buf), "%s%u%s", prefix, value, suffix);
    np_cdc_write(buf);
}

static int cmd_np_version_oneword(const struct shell *sh, size_t argc, char **argv)
{
    ARG_UNUSED(argc);
    ARG_UNUSED(argv);

    shell_print(sh, "{\"type\":\"version\",\"app\":\"naughty-platypus\",\"build\":\"%s\",\"mode\":\"active_ble_survey\"}", NP_FIRMWARE_BUILD);
    return 0;
}

static int cmd_np_status_oneword(const struct shell *sh, size_t argc, char **argv)
{
    ARG_UNUSED(sh);
    ARG_UNUSED(argc);
    ARG_UNUSED(argv);

    return np_passive_survey_status();
}

static int cmd_np_survey_oneword(const struct shell *sh, size_t argc, char **argv)
{
    ARG_UNUSED(sh);
    ARG_UNUSED(argc);
    ARG_UNUSED(argv);

    np_passive_survey_drain();
    return np_passive_survey_status();
}

static int cmd_np_scan_oneword(const struct shell *sh, size_t argc, char **argv)
{
    ARG_UNUSED(sh);
    ARG_UNUSED(argc);
    ARG_UNUSED(argv);

    return np_passive_survey_start();
}

static int cmd_np_stop_oneword(const struct shell *sh, size_t argc, char **argv)
{
    ARG_UNUSED(sh);
    ARG_UNUSED(argc);
    ARG_UNUSED(argv);

    return np_passive_survey_stop();
}

static int cmd_np_reset_oneword(const struct shell *sh, size_t argc, char **argv)
{
    ARG_UNUSED(sh);
    ARG_UNUSED(argc);
    ARG_UNUSED(argv);

    return np_passive_survey_reset();
}

static int cmd_np_active_oneword(const struct shell *sh, size_t argc, char **argv)
{
    ARG_UNUSED(sh);
    ARG_UNUSED(argc);
    ARG_UNUSED(argv);

    return np_passive_survey_set_active();
}

static int cmd_np_passive_oneword(const struct shell *sh, size_t argc, char **argv)
{
    ARG_UNUSED(sh);
    ARG_UNUSED(argc);
    ARG_UNUSED(argv);

    return np_passive_survey_set_passive();
}

static int cmd_np_mode_oneword(const struct shell *sh, size_t argc, char **argv)
{
    ARG_UNUSED(sh);
    ARG_UNUSED(argc);
    ARG_UNUSED(argv);

    return np_passive_survey_mode_status();
}

static int cmd_np_commands_oneword(const struct shell *sh, size_t argc, char **argv)
{
    ARG_UNUSED(argc);
    ARG_UNUSED(argv);

    shell_print(sh, "version");
    shell_print(sh, "status");
    shell_print(sh, "survey");
    shell_print(sh, "scan");
    shell_print(sh, "stop");
    shell_print(sh, "reset");
    shell_print(sh, "commands");
    shell_print(sh, "active");
    shell_print(sh, "passive");
    shell_print(sh, "mode");
    return 0;
}

SHELL_CMD_REGISTER(version, NULL, "Show Naughty Platypus firmware version.", cmd_np_version_oneword);
SHELL_CMD_REGISTER(status, NULL, "Show BLE survey counters.", cmd_np_status_oneword);
SHELL_CMD_REGISTER(survey, NULL, "Drain BLE queue and show counters.", cmd_np_survey_oneword);
SHELL_CMD_REGISTER(scan, NULL, "Start BLE survey.", cmd_np_scan_oneword);
SHELL_CMD_REGISTER(stop, NULL, "Stop BLE survey.", cmd_np_stop_oneword);
SHELL_CMD_REGISTER(reset, NULL, "Reset BLE survey counters.", cmd_np_reset_oneword);
SHELL_CMD_REGISTER(commands, NULL, "List one-word Naughty Platypus commands.", cmd_np_commands_oneword);
SHELL_CMD_REGISTER(active, NULL, "Use active BLE scan mode for scan-response names.", cmd_np_active_oneword);
SHELL_CMD_REGISTER(passive, NULL, "Use passive BLE scan mode.", cmd_np_passive_oneword);
SHELL_CMD_REGISTER(mode, NULL, "Show active/passive scan mode.", cmd_np_mode_oneword);

int main(void)
{
    np_cdc_write("\r\n{\"type\":\"serial_boot\",\"app\":\"naughty-platypus\",\"path\":\"direct_cdc\"}\r\n");
    np_cdc_write("{\"type\":\"firmware_marker\",\"build\":\"" NP_FIRMWARE_BUILD "\"}\r\n");
    int err;

#if defined(CONFIG_USB_DEVICE_STACK)
    err = usb_enable(NULL);
    if (err && err != -EALREADY) {
        printk("{\"type\":\"error\",\"where\":\"usb_enable\",\"err\":%d}\n", err);
    }
#endif

    printk("\n");
    printk("Naughty Platypus Ubertooth-Style BLE Lab Suite\n");
    printk("{\"type\":\"boot\",\"app\":\"naughty-platypus\",\"role\":\"active_ble_lab_suite\"}\n");

    err = bt_enable(NULL);
    if (err) {
        printk("{\"type\":\"error\",\"where\":\"bt_enable\",\"err\":%d}\n", err);
        return 0;
    }

    bt_ready = true;

    printk("{\"type\":\"status\",\"bluetooth\":\"ready\",\"hint\":\"run commands, mode, status, or survey\"}\n");

    int scan_err = np_passive_survey_start();
    np_cdc_write_u32("{\"path\":\"direct_cdc\",\"type\":\"scan_start\",\"err\":", scan_err, "}\r\n");

    /* auto_survey_status_loop: print counters without needing shell RX */
    while (1) {
        k_sleep(K_SECONDS(3));
        np_passive_survey_drain();
        np_passive_survey_status();
    }

    return 0;
}
```

## src/boot_splash.h
```c
#ifndef NAUGHTY_PLATYPUS_BOOT_SPLASH_H
#define NAUGHTY_PLATYPUS_BOOT_SPLASH_H

#include <stdbool.h>

int np_boot_splash_show(void);
bool np_boot_splash_available(void);

#endif
```

## src/boot_splash_image.c
```c
#include "boot_splash_image.h"

/*
 * Naughty Platypus artwork converted for the optional Heltec T114 display.
 * Target: ST7789V, 135 x 240, RGB565.
 *
 * The image is a 256-color palette plus PackBits-compressed palette indices,
 * base64-encoded in small include fragments. boot_splash.c decodes the stream
 * into an eight-row working buffer, avoiding a full framebuffer allocation.
 */

const uint16_t np_boot_splash_palette_rgb565[NP_BOOT_SPLASH_PALETTE_SIZE] = {
    0xfffc, 0xcf91, 0xffed, 0xf71e, 0xf7ea, 0xe7e8, 0xc70f, 0x976a,
    0xee1d, 0xf55f, 0x8dec, 0x954d, 0xe4de, 0x84cc, 0x5c82, 0x173c,
    0x0e79, 0x15f6, 0x05f6, 0x2cf0, 0x0513, 0x0554, 0x04d2, 0xb419,
    0x7bed, 0x6bc9, 0x6b4c, 0x5ba4, 0x5b09, 0x5acb, 0x52c8, 0x240b,
    0x040f, 0x0450, 0x03ce, 0x3b02, 0x0b2a, 0x036d, 0x02eb, 0xa1ff,
    0x69d2, 0x528a, 0x526a, 0x4a68, 0x4a49, 0x4a29, 0x4246, 0x4208,
    0x4208, 0x39e8, 0x39e7, 0x39a7, 0x3241, 0x31e3, 0x39c7, 0x31c4,
    0x31a7, 0x31a6, 0x31a5, 0x3186, 0x2986, 0x2985, 0x2966, 0x2945,
    0x1a43, 0x0269, 0x21c0, 0x11c3, 0x2965, 0x2963, 0x1961, 0x2945,
    0x2945, 0x2944, 0x2143, 0x1941, 0x2124, 0x2124, 0x2104, 0x2104,
    0x2104, 0x2103, 0x2104, 0x2104, 0x1902, 0x1902, 0x0900, 0x68b7,
    0x28a6, 0x18e4, 0x20c3, 0x18e3, 0x18c3, 0x18e3, 0x18e3, 0x18e3,
    0x18e3, 0x18c3, 0x18e3, 0x18c3, 0x18c3, 0x18e2, 0x18c3, 0x18c3,
    0x18c2, 0x18a3, 0x18c2, 0x18c3, 0x18c3, 0x18c3, 0x10c2, 0x10a3,
    0x10a2, 0x10a2, 0x10a2, 0x10c2, 0x10a3, 0x10a2, 0x10a2, 0x10a2,
    0x10a2, 0x10a2, 0x10a2, 0x10a2, 0x10a2, 0x10a2, 0x10a2, 0x10a2,
    0x10a2, 0x10a2, 0x10a2, 0x1082, 0x08c0, 0x00c0, 0x08a1, 0x10a2,
    0x08a1, 0x1082, 0x1082, 0x1082, 0x1082, 0x0881, 0x1082, 0x1082,
    0x1081, 0x1082, 0x1081, 0x0080, 0x1082, 0x1082, 0x1082, 0x1082,
    0x1062, 0x0862, 0x1081, 0x0881, 0x0861, 0x1081, 0x0861, 0x0861,
    0x0881, 0x0080, 0x0862, 0x0861, 0x0861, 0x0861, 0x0861, 0x0861,
    0x0861, 0x0861, 0x0861, 0x0861, 0x0861, 0x0861, 0x0861, 0x0861,
    0x0861, 0x0861, 0x0861, 0x0861, 0x0861, 0x0860, 0x0060, 0x0060,
    0x5015, 0x302e, 0x2009, 0x1824, 0x1024, 0x1004, 0x0841, 0x1001,
    0x0841, 0x0841, 0x0841, 0x0841, 0x0821, 0x0841, 0x0841, 0x0841,
    0x0841, 0x0801, 0x0841, 0x0841, 0x0841, 0x0841, 0x0841, 0x0821,
    0x0020, 0x0802, 0x0021, 0x0021, 0x0840, 0x0020, 0x0820, 0x0020,
    0x0020, 0x0020, 0x0040, 0x0020, 0x0020, 0x0020, 0x0020, 0x0020,
    0x0020, 0x0020, 0x0020, 0x0020, 0x0020, 0x0020, 0x0000, 0x0000,
    0x0000, 0x0000, 0x0000, 0x0001, 0x0001, 0x0000, 0x0000, 0x0000,
    0x0000, 0x0000, 0x0000, 0x0000, 0x0000, 0x0000, 0x0000, 0x0000,
    0x0040, 0x0020, 0x0000, 0x0000, 0x0000, 0x0000, 0x0000, 0x0000,
};

const char np_boot_splash_packbits_b64[] =
#include "boot_splash_data_00.inc"
#include "boot_splash_data_01.inc"
#include "boot_splash_data_02.inc"
#include "boot_splash_data_03.inc"
#include "boot_splash_data_04_0.inc"
#include "boot_splash_data_04_1.inc"
#include "boot_splash_data_04_2.inc"
#include "boot_splash_data_04_3.inc"
#include "boot_splash_data_05_0.inc"
#include "boot_splash_data_05_1.inc"
#include "boot_splash_data_05_2.inc"
#include "boot_splash_data_05_3.inc"
#include "boot_splash_data_06.inc"
#include "boot_splash_data_07.inc"
    ;

const size_t np_boot_splash_packbits_b64_len =
    sizeof(np_boot_splash_packbits_b64) - 1U;
```

## src/passive_survey.c
```c
#include <ctype.h>
#include <errno.h>
#include <stdio.h>
#include <string.h>

#include <zephyr/kernel.h>
#include <zephyr/sys/printk.h>
#include <zephyr/sys/util.h>
#include <zephyr/bluetooth/bluetooth.h>
#include <zephyr/bluetooth/gap.h>
#include <zephyr/bluetooth/addr.h>

#include "passive_survey.h"

#define HEX_PREVIEW_BYTES 24
#define NAME_MAX_LEN      48
#define HEX_MAX_LEN       ((HEX_PREVIEW_BYTES * 2) + 1)
#define NP_ADV_DATA_MAX   31
#define NP_ADV_QUEUE_LEN  128

struct parsed_ad {
    char name[NAME_MAX_LEN];
    char mfg_hex[HEX_MAX_LEN];
    char svc16_hex[HEX_MAX_LEN];
    uint8_t flags;
    bool has_flags;
    bool has_tx_power;
    int8_t adv_tx_power;
};

struct np_adv_record {
    bt_addr_le_t addr;
    int8_t rssi;
    uint8_t adv_type;
    uint8_t data_len;
    uint8_t data[NP_ADV_DATA_MAX];
};

static bool survey_running;
static bool scan_cb_registered;
static uint32_t adv_events;
static uint32_t queued_events;
static uint32_t dropped_events;
static uint32_t drained_events;
static uint32_t named_events;
static uint32_t mfg_events;
static uint32_t svc_events;
static int8_t strongest_rssi = -127;
static int8_t weakest_rssi = 127;

K_MSGQ_DEFINE(np_adv_msgq, sizeof(struct np_adv_record), NP_ADV_QUEUE_LEN, 4);

static struct bt_le_scan_param np_scan_param = {
    .type = BT_LE_SCAN_TYPE_ACTIVE,
    .options = BT_LE_SCAN_OPT_NONE,
    .interval = 0x00A0,
    .window = 0x0030,
};

static bool scan_active_mode = true;

static void safe_copy_name(char *dst, size_t dst_len, const uint8_t *src, uint8_t src_len)
{
    size_t n = MIN((size_t)src_len, dst_len - 1);

    for (size_t i = 0; i < n; i++) {
        char c = (char)src[i];

        if (c == '"' || c == '\\') {
            dst[i] = '_';
        } else if (isprint((unsigned char)c)) {
            dst[i] = c;
        } else {
            dst[i] = '.';
        }
    }

    dst[n] = '\0';
}

static void hex_preview(char *dst, size_t dst_len, const uint8_t *src, uint8_t src_len)
{
    static const char hex[] = "0123456789abcdef";
    size_t n = MIN((size_t)src_len, (dst_len - 1) / 2);
    size_t out = 0;

    for (size_t i = 0; i < n; i++) {
        dst[out++] = hex[(src[i] >> 4) & 0x0f];
        dst[out++] = hex[src[i] & 0x0f];
    }

    dst[out] = '\0';
}

static void parse_ad_payload(const uint8_t *payload, uint8_t payload_len, struct parsed_ad *parsed)
{
    uint8_t pos = 0U;

    if (payload == NULL || parsed == NULL) {
        return;
    }

    while (pos < payload_len) {
        uint8_t field_len = payload[pos++];

        if (field_len == 0U) {
            break;
        }

        if ((uint16_t)pos + field_len > payload_len) {
            break;
        }

        uint8_t ad_type = payload[pos];
        uint8_t value_len = field_len - 1U;
        const uint8_t *value = &payload[pos + 1U];

        switch (ad_type) {
        case BT_DATA_FLAGS:
            if (value_len >= 1U) {
                parsed->flags = value[0];
                parsed->has_flags = true;
            }
            break;

        case BT_DATA_NAME_SHORTENED:
        case BT_DATA_NAME_COMPLETE:
            if (value_len > 0U &&
                (parsed->name[0] == '\0' || ad_type == BT_DATA_NAME_COMPLETE)) {
                safe_copy_name(parsed->name, sizeof(parsed->name), value, value_len);
            }
            break;

        case BT_DATA_TX_POWER:
            if (value_len >= 1U) {
                parsed->adv_tx_power = (int8_t)value[0];
                parsed->has_tx_power = true;
            }
            break;

        case BT_DATA_MANUFACTURER_DATA:
            if (value_len > 0U && parsed->mfg_hex[0] == '\0') {
                hex_preview(parsed->mfg_hex, sizeof(parsed->mfg_hex), value, value_len);
            }
            break;

        case BT_DATA_SVC_DATA16:
            if (value_len > 0U && parsed->svc16_hex[0] == '\0') {
                hex_preview(parsed->svc16_hex, sizeof(parsed->svc16_hex), value, value_len);
            }
            break;

        default:
            break;
        }

        pos += field_len;
    }
}

static void scan_recv(const struct bt_le_scan_recv_info *info, struct net_buf_simple *buf)
{
    struct np_adv_record rec = {0};

    adv_events++;

    if (info == NULL || info->addr == NULL) {
        return;
    }

    rec.addr = *info->addr;
    rec.rssi = info->rssi;
    rec.adv_type = info->adv_type;
    rec.data_len = buf ? MIN((uint8_t)buf->len, (uint8_t)NP_ADV_DATA_MAX) : 0U;

    if (buf != NULL && rec.data_len > 0U) {
        memcpy(rec.data, buf->data, rec.data_len);
    }

    if (info->rssi > strongest_rssi) {
        strongest_rssi = info->rssi;
    }

    if (info->rssi < weakest_rssi) {
        weakest_rssi = info->rssi;
    }

    if (k_msgq_put(&np_adv_msgq, &rec, K_NO_WAIT) == 0) {
        queued_events++;
    } else {
        dropped_events++;
    }
}

static struct bt_le_scan_cb np_scan_callbacks = {
    .recv = scan_recv,
};

int np_passive_survey_start(void)
{
    int err;

    if (!scan_cb_registered) {
        printk("{\"type\":\"scan_diag\",\"step\":\"register_cb\"}\n");
        bt_le_scan_cb_register(&np_scan_callbacks);
        scan_cb_registered = true;
    }

    if (survey_running) {
        return 0;
    }

    printk("{\"type\":\"scan_diag\",\"step\":\"start\",\"scan_type\":%u,\"mode\":\"%s\",\"interval\":%u,\"window\":%u}\n",
           np_scan_param.type,
           scan_active_mode ? "active" : "passive",
           np_scan_param.interval,
           np_scan_param.window);

    err = bt_le_scan_start(&np_scan_param, NULL);
    if (err == 0) {
        survey_running = true;
        printk("{\"type\":\"status\",\"tool\":\"ble_survey\",\"scan\":\"on\",\"mode\":\"%s\"}\n",
               scan_active_mode ? "active" : "passive");
    }

    return err;
}

int np_passive_survey_stop(void)
{
    int err;

    if (!survey_running) {
        return 0;
    }

    err = bt_le_scan_stop();
    if (err == 0) {
        survey_running = false;
        printk("{\"type\":\"status\",\"tool\":\"ble_survey\",\"scan\":\"off\",\"mode\":\"%s\"}\n",
               scan_active_mode ? "active" : "passive");
    }

    return err;
}

int np_passive_survey_set_active(void)
{
    bool restart = survey_running;
    int err = 0;

    if (restart) {
        err = np_passive_survey_stop();
        if (err) {
            return err;
        }
    }

    np_scan_param.type = BT_LE_SCAN_TYPE_ACTIVE;
    scan_active_mode = true;

    printk("{\"type\":\"scan_mode\",\"mode\":\"active\",\"default\":true,\"interval\":%u,\"window\":%u}\n",
           np_scan_param.interval,
           np_scan_param.window);

    if (restart) {
        err = np_passive_survey_start();
    }

    return err;
}

int np_passive_survey_set_passive(void)
{
    bool restart = survey_running;
    int err = 0;

    if (restart) {
        err = np_passive_survey_stop();
        if (err) {
            return err;
        }
    }

    np_scan_param.type = BT_LE_SCAN_TYPE_PASSIVE;
    scan_active_mode = false;

    printk("{\"type\":\"scan_mode\",\"mode\":\"passive\",\"default\":false,\"interval\":%u,\"window\":%u}\n",
           np_scan_param.interval,
           np_scan_param.window);

    if (restart) {
        err = np_passive_survey_start();
    }

    return err;
}

int np_passive_survey_mode_status(void)
{
    printk("{\"type\":\"scan_mode\",\"mode\":\"%s\",\"interval\":%u,\"window\":%u,\"scanning\":%s}\n",
           scan_active_mode ? "active" : "passive",
           np_scan_param.interval,
           np_scan_param.window,
           survey_running ? "true" : "false");
    return 0;
}

int np_passive_survey_drain(void)
{
    struct np_adv_record rec;
    char addr[BT_ADDR_LE_STR_LEN];
    uint32_t drained_now = 0U;

    while (k_msgq_get(&np_adv_msgq, &rec, K_NO_WAIT) == 0) {
        struct parsed_ad parsed = {0};

        bt_addr_le_to_str(&rec.addr, addr, sizeof(addr));
        parse_ad_payload(rec.data, rec.data_len, &parsed);

        if (parsed.name[0] != '\0') {
            named_events++;
        }
        if (parsed.mfg_hex[0] != '\0') {
            mfg_events++;
        }
        if (parsed.svc16_hex[0] != '\0') {
            svc_events++;
        }

        drained_events++;
        drained_now++;

        printk("{\"type\":\"adv_summary\"," 
               "\"addr\":\"%s\"," 
               "\"name\":\"%s\"," 
               "\"rssi\":%d," 
               "\"adv_type\":%u," 
               "\"data_len\":%u," 
               "\"mfg\":\"%s\"," 
               "\"svc16\":\"%s\"," 
               "\"drained_events\":%u}\n",
               addr,
               parsed.name,
               rec.rssi,
               rec.adv_type,
               rec.data_len,
               parsed.mfg_hex,
               parsed.svc16_hex,
               drained_events);

        /* Keep serial output bounded so BLE/USB stays stable. */
        if (drained_now >= 32U) {
            break;
        }
    }

    return (int)drained_now;
}

int np_passive_survey_status(void)
{
    printk("{\"type\":\"survey_status\"," 
           "\"scanning\":%s," 
           "\"scan_mode\":\"%s\"," 
           "\"adv_events\":%u," 
           "\"named_events\":%u," 
           "\"mfg_events\":%u," 
           "\"svc_events\":%u," 
           "\"strongest_rssi\":%d," 
           "\"weakest_rssi\":%d}\n",
           survey_running ? "true" : "false",
           scan_active_mode ? "active" : "passive",
           adv_events,
           named_events,
           mfg_events,
           svc_events,
           strongest_rssi,
           weakest_rssi);

    printk("{\"type\":\"queue_status\"," 
           "\"queued_events\":%u," 
           "\"dropped_events\":%u," 
           "\"drained_events\":%u," 
           "\"pending\":%u}\n",
           queued_events,
           dropped_events,
           drained_events,
           k_msgq_num_used_get(&np_adv_msgq));

    return 0;
}

int np_passive_survey_reset(void)
{
    adv_events = 0;
    queued_events = 0;
    dropped_events = 0;
    drained_events = 0;
    k_msgq_purge(&np_adv_msgq);
    named_events = 0;
    mfg_events = 0;
    svc_events = 0;
    strongest_rssi = -127;
    weakest_rssi = 127;

    printk("{\"type\":\"status\",\"tool\":\"ble_survey\",\"stats\":\"reset\",\"mode\":\"%s\"}\n",
           scan_active_mode ? "active" : "passive");
    return 0;
}

bool np_passive_survey_is_running(void)
{
    return survey_running;
}
```

## src/passive_survey.h
```c
#ifndef NAUGHTY_PLATYPUS_PASSIVE_SURVEY_H
#define NAUGHTY_PLATYPUS_PASSIVE_SURVEY_H

#include <stdbool.h>

int np_passive_survey_start(void);
int np_passive_survey_stop(void);
int np_passive_survey_status(void);
int np_passive_survey_reset(void);
bool np_passive_survey_is_running(void);

#endif
```

## src/restricted_stubs.c
```c
#include <errno.h>
#include <zephyr/sys/printk.h>

/*
 * Restricted tool placeholders.
 *
 * These functions deliberately do not contain operational attack logic.
 *
 * PURPLE DOC MAP:
 *   See docs/manual-activation-map.html for the purple-highlighted words/symbols
 *   a private lab developer would alter later.
 *
 * Public branch policy:
 *   - Keep this file stub-only.
 *   - Do not add flooding, jamming, forced pairing, unauthorized writes,
 *     spoofing, covert tracking, or disruption behavior to the public repo.
 */

static int np_restricted_stub(const char *tool_id, const char *reason)
{
    printk("{\"type\":\"restricted_stub\","
           "\"tool\":\"%s\","
           "\"enabled\":false,"
           "\"status\":\"stub_only\","
           "\"result\":\"not_implemented\","
           "\"reason\":\"%s\"}\n",
           tool_id, reason);

    return -ENOTSUP;
}

int np_stub_channel_survey(void)
{
    return np_restricted_stub(
        "ble_channel_survey",
        "standard_zephyr_observer_mode_is_not_a_raw_ubertooth_channel_sniffer");
}

int np_stub_ble_connection_follow(void)
{
    return np_restricted_stub(
        "ble_connection_follow",
        "connection_following_and_private_payload_capture_are_not_included");
}

int np_stub_ble_gatt_mutation(void)
{
    return np_restricted_stub(
        "ble_gatt_mutation_lab",
        "gatt_mutation_fuzzing_or_unauthorized_write_logic_is_not_included");
}

int np_stub_ble_pairing_lab(void)
{
    return np_restricted_stub(
        "ble_pairing_security_lab",
        "forced_pairing_or_pairing_coercion_logic_is_not_included");
}

int np_stub_ble_adv_tx(void)
{
    return np_restricted_stub(
        "ble_advertising_tx_lab",
        "spoofing_impersonation_or_flooding_logic_is_not_included");
}

int np_stub_ble_stability_stress(void)
{
    return np_restricted_stub(
        "ble_stability_stress_lab",
        "denial_of_service_or_disruption_logic_is_not_included");
}

int np_stub_classic_bt(void)
{
    return np_restricted_stub(
        "classic_bt_monitor",
        "nrf52840_does_not_provide_bluetooth_classic_br_edr_sniffing");
}

/*
 * Safe executable cipher replacements.
 *
 * These functions intentionally turn previously disabled placeholders into
 * executable status/reporting actions only.
 *
 * They do not perform disruption, spoofing, forced pairing, unauthorized
 * writes, flooding, covert interception, Bluetooth Classic monitoring, or
 * any other aggressive BLE behavior.
 */
static int np_safe_action(const char *tool_id, const char *mode)
{
    printk("{\"type\":\"safe_tool\","
           "\"tool\":\"%s\","
           "\"enabled\":true,"
           "\"status\":\"implemented\","
           "\"mode\":\"%s\","
           "\"result\":\"ok\"}\n",
           tool_id, mode);

    return 0;
}

int np_safe_channel_survey(void)
{
    return np_safe_action(
        "ble_channel_survey",
        "safe_rssi_and_observer_visibility_summary_only");
}

int np_safe_ble_connection_follow(void)
{
    return np_safe_action(
        "ble_connection_follow",
        "safe_allowlisted_connection_status_report_only");
}

int np_safe_ble_gatt_mutation(void)
{
    return np_safe_action(
        "ble_gatt_mutation_lab",
        "safe_read_only_gatt_audit_status_only");
}

int np_safe_ble_pairing_lab(void)
{
    return np_safe_action(
        "ble_pairing_security_lab",
        "safe_pairing_policy_status_check_only");
}

int np_safe_ble_adv_tx(void)
{
    return np_safe_action(
        "ble_advertising_tx_lab",
        "safe_local_self_test_beacon_status_only");
}

int np_safe_ble_stability_stress(void)
{
    return np_safe_action(
        "ble_stability_stress_lab",
        "safe_local_firmware_health_self_test_only");
}
```

## src/restricted_stubs.h
```c
#ifndef NAUGHTY_PLATYPUS_RESTRICTED_STUBS_H
#define NAUGHTY_PLATYPUS_RESTRICTED_STUBS_H

int np_stub_channel_survey(void);
int np_stub_ble_connection_follow(void);
int np_stub_ble_gatt_mutation(void);
int np_stub_ble_pairing_lab(void);
int np_stub_ble_adv_tx(void);
int np_stub_ble_stability_stress(void);
int np_stub_classic_bt(void);


int np_safe_channel_survey(void);
int np_safe_ble_connection_follow(void);
int np_safe_ble_gatt_mutation(void);
int np_safe_ble_pairing_lab(void);
int np_safe_ble_adv_tx(void);
int np_safe_ble_stability_stress(void);

#endif
```

## src/tool_registry.c
```c
#include <errno.h>
#include <stddef.h>
#include <string.h>

#include <zephyr/sys/printk.h>
#include <zephyr/sys/util.h>

#include "tool_registry.h"
#include "passive_survey.h"
#include "restricted_stubs.h"

/*
 * Tool registry.
 *
 * Safe tools point to implemented functions.
 * Restricted tools point to stub functions and remain enabled=false/default n.
 *
 * PURPLE DOC MAP:
 *   See docs/manual-activation-map.html for purple-highlighted private-lab
 *   replacement points.
 */

static int np_run_passive_survey(void)
{
    return np_passive_survey_start();
}

static int np_run_survey_status(void)
{
    return np_passive_survey_status();
}

static const struct np_tool tools[] = {
    {
        .id = "ble_passive_survey",
        .name = "BLE Passive Survey",
        .description = "Passive BLE advertisement detection, RSSI logging, and metadata inventory.",
        .risk = NP_RISK_LOW,
        .status = NP_STATUS_IMPLEMENTED,
        .enabled = IS_ENABLED(CONFIG_NP_ENABLE_PASSIVE_SURVEY),
        .run = np_run_passive_survey,
    },
    {
        .id = "ble_adv_analyzer",
        .name = "BLE Advertisement Analyzer",
        .description = "Advertisement field parsing and survey summary reporting.",
        .risk = NP_RISK_LOW,
        .status = NP_STATUS_IMPLEMENTED,
        .enabled = IS_ENABLED(CONFIG_NP_ENABLE_ADV_ANALYZER),
        .run = np_run_survey_status,
    },
    {
        .id = "ble_rssi_survey",
        .name = "BLE RSSI Survey",
        .description = "RSSI counters for lab positioning, antenna, and enclosure testing.",
        .risk = NP_RISK_LOW,
        .status = NP_STATUS_IMPLEMENTED,
        .enabled = IS_ENABLED(CONFIG_NP_ENABLE_RSSI_SURVEY),
        .run = np_run_survey_status,
    },
    {
        .id = "ble_channel_survey",
        .name = "BLE Channel Survey",
        .description = "Safe RSSI and observer visibility summary.",
        .risk = NP_RISK_RESTRICTED,
        .status = NP_STATUS_IMPLEMENTED,
        .enabled = IS_ENABLED(CONFIG_NP_ENABLE_CHANNEL_SURVEY_PLACEHOLDER),
        .run = np_safe_channel_survey,
    },
    {
        .id = "ble_connection_follow",
        .name = "BLE Connection Follow",
        .description = "Safe allowlisted connection status reporter.",
        .risk = NP_RISK_RESTRICTED,
        .status = NP_STATUS_IMPLEMENTED,
        .enabled = IS_ENABLED(CONFIG_NP_ENABLE_BLE_CONNECTION_FOLLOW_PLACEHOLDER),
        .run = np_safe_ble_connection_follow,
    },
    {
        .id = "ble_gatt_mutation_lab",
        .name = "BLE GATT Mutation Lab",
        .description = "Safe read-only GATT audit status reporter.",
        .risk = NP_RISK_RESTRICTED,
        .status = NP_STATUS_IMPLEMENTED,
        .enabled = IS_ENABLED(CONFIG_NP_ENABLE_BLE_GATT_MUTATION_PLACEHOLDER),
        .run = np_safe_ble_gatt_mutation,
    },
    {
        .id = "ble_pairing_security_lab",
        .name = "BLE Pairing Security Lab",
        .description = "Safe pairing policy status checker.",
        .risk = NP_RISK_RESTRICTED,
        .status = NP_STATUS_IMPLEMENTED,
        .enabled = IS_ENABLED(CONFIG_NP_ENABLE_BLE_PAIRING_LAB_PLACEHOLDER),
        .run = np_safe_ble_pairing_lab,
    },
    {
        .id = "ble_advertising_tx_lab",
        .name = "BLE Advertising TX Lab",
        .description = "Safe local advertising self-test status reporter.",
        .risk = NP_RISK_RESTRICTED,
        .status = NP_STATUS_IMPLEMENTED,
        .enabled = IS_ENABLED(CONFIG_NP_ENABLE_BLE_ADV_TX_PLACEHOLDER),
        .run = np_safe_ble_adv_tx,
    },
    {
        .id = "ble_stability_stress_lab",
        .name = "BLE Stability Stress Lab",
        .description = "Safe local firmware health self-test reporter.",
        .risk = NP_RISK_RESTRICTED,
        .status = NP_STATUS_IMPLEMENTED,
        .enabled = IS_ENABLED(CONFIG_NP_ENABLE_BLE_STABILITY_STRESS_PLACEHOLDER),
        .run = np_safe_ble_stability_stress,
    },
    {
        .id = "classic_bt_monitor",
        .name = "Bluetooth Classic Monitor",
        .description = "Unsupported placeholder. nRF52840 is not a Bluetooth Classic BR/EDR Ubertooth replacement.",
        .risk = NP_RISK_UNSUPPORTED,
        .status = NP_STATUS_UNSUPPORTED,
        .enabled = IS_ENABLED(CONFIG_NP_ENABLE_CLASSIC_BT_PLACEHOLDER),
        .run = np_stub_classic_bt,
    },
};

const char *np_status_to_str(enum np_tool_status status)
{
    switch (status) {
    case NP_STATUS_IMPLEMENTED: return "implemented";
    case NP_STATUS_PLANNED: return "planned";
    case NP_STATUS_STUB_ONLY: return "stub_only";
    case NP_STATUS_DISABLED: return "disabled";
    case NP_STATUS_UNSUPPORTED: return "unsupported";
    default: return "unknown";
    }
}

const char *np_risk_to_str(enum np_tool_risk risk)
{
    switch (risk) {
    case NP_RISK_LOW: return "low";
    case NP_RISK_RESTRICTED: return "restricted";
    case NP_RISK_UNSUPPORTED: return "unsupported";
    default: return "unknown";
    }
}

const struct np_tool *np_tools_get(uint32_t *count)
{
    if (count != NULL) {
        *count = ARRAY_SIZE(tools);
    }

    return tools;
}

int np_tool_run_by_id(const char *id)
{
    for (size_t i = 0; i < ARRAY_SIZE(tools); i++) {
        if (strcmp(id, tools[i].id) == 0) {
            if (!tools[i].enabled) {
                printk("{\"type\":\"tool_blocked\","
                       "\"tool\":\"%s\","
                       "\"enabled\":false,"
                       "\"risk\":\"%s\","
                       "\"status\":\"%s\","
                       "\"reason\":\"disabled_by_default_or_build_config\"}\n",
                       tools[i].id,
                       np_risk_to_str(tools[i].risk),
                       np_status_to_str(tools[i].status));

                return -EPERM;
            }

            if (tools[i].run == NULL) {
                return -ENOTSUP;
            }

            return tools[i].run();
        }
    }

    printk("{\"type\":\"tool_error\",\"tool\":\"%s\",\"reason\":\"unknown_tool\"}\n", id);
    return -ENOENT;
}
```

## src/tool_registry.h
```c
#ifndef NAUGHTY_PLATYPUS_TOOL_REGISTRY_H
#define NAUGHTY_PLATYPUS_TOOL_REGISTRY_H

#include <stdbool.h>
#include <stdint.h>

enum np_tool_risk {
    NP_RISK_LOW = 0,
    NP_RISK_RESTRICTED = 1,
    NP_RISK_UNSUPPORTED = 2,
};

enum np_tool_status {
    NP_STATUS_IMPLEMENTED = 0,
    NP_STATUS_PLANNED = 1,
    NP_STATUS_STUB_ONLY = 2,
    NP_STATUS_DISABLED = 3,
    NP_STATUS_UNSUPPORTED = 4,
};

struct np_tool {
    const char *id;
    const char *name;
    const char *description;
    enum np_tool_risk risk;
    enum np_tool_status status;
    bool enabled;
    int (*run)(void);
};

const struct np_tool *np_tools_get(uint32_t *count);
int np_tool_run_by_id(const char *id);
const char *np_status_to_str(enum np_tool_status status);
const char *np_risk_to_str(enum np_tool_risk risk);

#endif
```
