## CMakeLists.txt
```
cmake_minimum_required(VERSION 3.20.0)

find_package(Zephyr REQUIRED HINTS $ENV{ZEPHYR_BASE})
project(platypus_sniffer)

target_sources(app PRIVATE
    src/main.c
    src/radio_ble.c
    src/channel_hop.c
    src/proto_framer.c
    src/usb_transport.c
)

target_include_directories(app PRIVATE src)
```

## prj.conf
```kconfig
# Platypus Sniffer - bare-radio BLE promiscuous sniffer
#
# We deliberately do NOT enable Zephyr's Bluetooth host/controller stack.
# The nRF52840 RADIO peripheral is driven directly in BLE PHY mode so we can
# receive every over-the-air packet on a channel (advertising or data),
# instead of only what a conformant BLE controller would hand to a host.
CONFIG_BT=n

# --- Core kernel ---
CONFIG_MAIN_STACK_SIZE=4096
CONFIG_HEAP_MEM_POOL_SIZE=16384

# --- Direct hardware access ---
# NOTE: our code (src/radio_ble.c) talks to the RADIO and TIMER1
# peripherals through the raw register-level HAL (hal/nrf_radio.h,
# hal/nrf_timer.h) rather than through nrfx's higher-level driver layer, so
# it does not need - and current Zephyr no longer even defines -
# CONFIG_NRFX_RADIO, CONFIG_NRFX_TIMER1/TIMER2 (now a single CONFIG_NRFX_TIMER
# driver-wide option), or CONFIG_NRFX_PPI (replaced by CONFIG_NRFX_GPPI).
# Those raw HAL headers are always available, no Kconfig gate required.
CONFIG_NRFX_CLOCK=y

# --- USB: the newer "USB device stack next" (USBD), not the legacy stack ---
# This board's devicetree has one CDC-ACM node, and both the legacy stack's
# class driver and this newer stack's class driver bind to it by default -
# enabling both at once fails the link with "multiple definition of
# ...dts_ord...". src/usb_transport.c is written against the USBD_* API
# (see Zephyr's samples/subsys/usb/cdc_acm for the reference pattern this
# follows), so the legacy stack stays off.
CONFIG_USB_DEVICE_STACK=n
CONFIG_USB_DEVICE_STACK_NEXT=y
CONFIG_USBD_CDC_ACM_CLASS=y
CONFIG_SERIAL=y
CONFIG_UART_LINE_CTRL=y

# --- Logging (kept off UART since UART is the capture transport) ---
CONFIG_LOG=y
CONFIG_LOG_BACKEND_RTT=y
CONFIG_USE_SEGGER_RTT=y
CONFIG_LOG_BACKEND_UART=n

# --- Same flash layout fix Platypus already needed on this board ---
CONFIG_USE_DT_CODE_PARTITION=n
CONFIG_FLASH_LOAD_OFFSET=0x1000
CONFIG_FLASH_LOAD_SIZE=0xdf000
```

## src/main.c
```c
/*
 * Platypus Sniffer firmware entry point.
 *
 * On boot: bring up USB (framed protocol transport), bring up the raw BLE
 * radio, and start promiscuous scanning of the three advertising channels.
 * From there, channel_hop.c drives everything else (including opportunistic
 * connection-following when it sees a CONNECT_IND).
 */
#include <zephyr/kernel.h>

#include "radio_ble.h"
#include "channel_hop.h"
#include "proto_framer.h"

static void on_capture(const struct ble_capture *pkt)
{
    channel_hop_on_capture(pkt);
}

int main(void)
{
    proto_framer_init();
    proto_framer_send_version();

    radio_ble_init(on_capture);
    channel_hop_init();
    channel_hop_start_adv_scan();

    while (1) {
        proto_framer_poll_host_commands();
        k_sleep(K_MSEC(5));
    }

    return 0;
}
```

## src/channel_hop.c
```c
#include "channel_hop.h"
#include "radio_ble.h"
#include "proto_framer.h"

#include <zephyr/kernel.h>
#include <string.h>

static enum sniff_mode mode = SNIFF_MODE_ADV;
static const uint8_t adv_channels[3] = {37, 38, 39};
static uint8_t adv_idx;

/* Data channel remapping table for a connection (CONNECT_IND's ChM). */
static uint8_t chan_map[37];
static uint8_t num_used_channels;
static uint8_t hop_increment;
static uint8_t last_unmapped_chan;
static uint32_t conn_access_address;
static uint32_t conn_crc_init;

void channel_hop_init(void)
{
    mode = SNIFF_MODE_ADV;
    adv_idx = 0;
}

void channel_hop_start_adv_scan(void)
{
    mode = SNIFF_MODE_ADV;
    adv_idx = 0;
    radio_ble_set_channel(adv_channels[0], BLE_ADV_ACCESS_ADDRESS,
                   BLE_ADV_CRC_INIT);
}

enum sniff_mode channel_hop_get_mode(void)
{
    return mode;
}

/* BLE Core spec Vol 6, Part B, 4.5.8.2: data channel selection algorithm #1. */
static uint8_t next_data_channel(void)
{
    uint8_t unmapped = (last_unmapped_chan + hop_increment) % 37;
    last_unmapped_chan = unmapped;

    if (chan_map[unmapped]) {
        return unmapped;
    }

    /* remap used channel index deterministically, per spec section 4.5.8.2 */
    uint8_t remainder = unmapped % num_used_channels;
    uint8_t idx = 0, count = 0;
    for (idx = 0; idx < 37; idx++) {
        if (chan_map[idx]) {
            if (count == remainder) {
                return idx;
            }
            count++;
        }
    }
    return unmapped; /* unreachable if chan_map is well formed */
}

/* Parse a CONNECT_IND PDU (PDU type 0x5, seen on an advertising channel)
 * and arm connection-following mode from its fields. Offsets below follow
 * Core spec Vol 6, Part B, 2.3.3.1 (LLData: AA, CRCInit, WinSize, WinOffset,
 * Interval, Latency, Timeout, ChM[5], Hop+SCA). */
static void try_parse_connect_ind(const struct ble_capture *pkt)
{
    if (!pkt->crc_ok || pkt->length < 2 + 34) {
        return;
    }
    const uint8_t *pdu = pkt->pdu;
    uint8_t pdu_type = pdu[0] & 0x0F;
    if (pdu_type != 0x5 /* CONNECT_IND */) {
        return;
    }

    const uint8_t *lldata = &pdu[2] + 12; /* skip header, AdvA, InitA */
    conn_access_address = lldata[0] | (lldata[1] << 8) |
                  (lldata[2] << 16) | ((uint32_t)lldata[3] << 24);
    conn_crc_init = lldata[4] | (lldata[5] << 8) | (lldata[6] << 16);

    const uint8_t *chm_bytes = &lldata[12];
    num_used_channels = 0;
    for (int i = 0; i < 37; i++) {
        bool used = (chm_bytes[i / 8] >> (i % 8)) & 0x1;
        chan_map[i] = used;
        if (used) {
            num_used_channels++;
        }
    }
    hop_increment = lldata[17] & 0x1F;
    last_unmapped_chan = 0;

    if (num_used_channels == 0) {
        return; /* malformed / can't follow */
    }

    mode = SNIFF_MODE_FOLLOW;
    uint8_t first = next_data_channel();
    radio_ble_set_channel(first, conn_access_address, conn_crc_init);
}

void channel_hop_on_capture(const struct ble_capture *pkt)
{
    proto_framer_send_capture(pkt);

    if (mode == SNIFF_MODE_ADV) {
        try_parse_connect_ind(pkt);
        if (mode == SNIFF_MODE_ADV) {
            adv_idx = (adv_idx + 1) % 3;
            radio_ble_set_channel(adv_channels[adv_idx],
                           BLE_ADV_ACCESS_ADDRESS,
                           BLE_ADV_CRC_INIT);
        }
        return;
    }

    /* FOLLOW mode: retune for the next connection event. In this first
     * cut we hop on every received packet rather than on a TIMER1-driven
     * connEvent schedule, which works while packets are flowing but will
     * drift/lose lock during silent connection intervals - see
     * docs/SNIFFER-ARCHITECTURE.md "Known limitations". */
    uint8_t next = next_data_channel();
    radio_ble_set_channel(next, conn_access_address, conn_crc_init);
}
```

## src/channel_hop.h
```c
#ifndef PLATYPUS_CHANNEL_HOP_H_
#define PLATYPUS_CHANNEL_HOP_H_

#include <stdint.h>
#include <stdbool.h>
#include "radio_ble.h"

enum sniff_mode {
    SNIFF_MODE_ADV,      /* promiscuous scan of channels 37/38/39 */
    SNIFF_MODE_FOLLOW,   /* locked onto one established connection */
};

/* Advertising access address / CRC init, fixed by the BLE spec. */
#define BLE_ADV_ACCESS_ADDRESS 0x8E89BED6u
#define BLE_ADV_CRC_INIT       0x555555u

/*
 * Drives the sniffer's capture state machine:
 *  - In ADV mode, round-robins channels 37/38/39 looking for any
 *    advertising PDU (ADV_IND, ADV_NONCONN_IND, SCAN_RSP, ...).
 *  - When told to follow a connection (from a parsed CONNECT_IND), it
 *    switches to FOLLOW mode: computes the BLE channel-selection-algorithm
 *    hop sequence from the CONNECT_IND's channel map / hop increment, and
 *    retunes the radio on each connection event using TIMER1 so we stay
 *    locked to the same channel sequence as the two devices we're
 *    eavesdropping on.
 *
 * NOTE: the connection-following hop timing in this firmware is a first
 * cut. Getting the retune timing tight enough to never miss a connection
 * event needs on-hardware calibration (anchor-point drift, clock skew)
 * that can't be verified without a real board in hand - see
 * docs/SNIFFER-ARCHITECTURE.md for what to tighten up first.
 */
void channel_hop_init(void);
void channel_hop_start_adv_scan(void);
void channel_hop_on_capture(const struct ble_capture *pkt);
enum sniff_mode channel_hop_get_mode(void);

#endif /* PLATYPUS_CHANNEL_HOP_H_ */
```

## src/proto_framer.c
```c
#include "proto_framer.h"
#include "usb_transport.h"
#include "channel_hop.h"

#include <string.h>

#define FW_VERSION_STRING "platypus-sniffer-0.1.0"

static uint16_t crc16_ccitt_false(const uint8_t *data, size_t len)
{
    uint16_t crc = 0xFFFF;
    for (size_t i = 0; i < len; i++) {
        crc ^= (uint16_t)data[i] << 8;
        for (int b = 0; b < 8; b++) {
            crc = (crc & 0x8000) ? (crc << 1) ^ 0x1021 : (crc << 1);
        }
    }
    return crc;
}

static void send_frame(uint8_t type, const uint8_t *payload, uint16_t len)
{
    uint8_t header[5];
    header[0] = PROTO_MAGIC0;
    header[1] = PROTO_MAGIC1;
    header[2] = (len + 1) & 0xFF;
    header[3] = ((len + 1) >> 8) & 0xFF;
    header[4] = type;

    uint8_t crc_buf[1 + 256];
    crc_buf[0] = type;
    if (len) {
        memcpy(&crc_buf[1], payload, len);
    }
    uint16_t crc = crc16_ccitt_false(crc_buf, len + 1);
    uint8_t crc_bytes[2] = { crc & 0xFF, (crc >> 8) & 0xFF };

    usb_transport_write(header, sizeof(header));
    if (len) {
        usb_transport_write(payload, len);
    }
    usb_transport_write(crc_bytes, sizeof(crc_bytes));
}

void proto_framer_init(void)
{
    usb_transport_init();
}

void proto_framer_send_capture(const struct ble_capture *pkt)
{
    /* Wire layout kept flat/explicit (no struct padding games) so
     * tools/platypus_proto.py can decode it with a plain struct.unpack. */
    uint8_t buf[4 + 1 + 1 + 1 + 4 + 8 + 1 + BLE_MAX_PDU_LEN];
    size_t off = 0;

    memcpy(&buf[off], &pkt->access_address, 4); off += 4;
    buf[off++] = pkt->channel;
    buf[off++] = (uint8_t)pkt->rssi_dbm;
    buf[off++] = pkt->crc_ok ? 1 : 0;
    memcpy(&buf[off], &pkt->crc, 4); off += 4;
    memcpy(&buf[off], &pkt->timestamp_us, 8); off += 8;
    buf[off++] = pkt->length;
    memcpy(&buf[off], pkt->pdu, pkt->length); off += pkt->length;

    send_frame(PROTO_MSG_CAPTURE, buf, (uint16_t)off);
}

void proto_framer_send_version(void)
{
    send_frame(PROTO_MSG_VERSION, (const uint8_t *)FW_VERSION_STRING,
           sizeof(FW_VERSION_STRING) - 1);
}

void proto_framer_poll_host_commands(void)
{
    uint8_t cmd;
    while (usb_transport_read_cmd_byte(&cmd)) {
        switch (cmd) {
        case PROTO_MSG_PING:
            send_frame(PROTO_MSG_PONG, NULL, 0);
            break;
        case PROTO_MSG_SET_MODE:
            channel_hop_start_adv_scan();
            break;
        default:
            break;
        }
    }
}
```

## src/proto_framer.h
```c
#ifndef PLATYPUS_PROTO_FRAMER_H_
#define PLATYPUS_PROTO_FRAMER_H_

#include "radio_ble.h"

/*
 * Wire protocol between the dongle and tools/platypus_proto.py on the host.
 * Deliberately simple/textbook so the host side is easy to read & extend -
 * this is *not* trying to be HCI; it's a thin framed pipe for raw capture
 * records and a handful of control commands.
 *
 * Frame: 0xAA 0x55 | len:u16 LE | type:u8 | payload[len] | crc16:u16 LE
 * CRC16 is CRC-16/CCITT-FALSE over (len bytes of type+payload).
 */
#define PROTO_MAGIC0 0xAA
#define PROTO_MAGIC1 0x55

enum proto_msg_type {
    PROTO_MSG_CAPTURE   = 0x01, /* device -> host: a struct ble_capture */
    PROTO_MSG_PING      = 0x02, /* host -> device */
    PROTO_MSG_PONG      = 0x03, /* device -> host */
    PROTO_MSG_SET_MODE  = 0x04, /* host -> device: 0=adv scan,1=idle */
    PROTO_MSG_VERSION   = 0x05, /* device -> host: version string */
};

void proto_framer_init(void);
void proto_framer_send_capture(const struct ble_capture *pkt);
void proto_framer_send_version(void);
void proto_framer_poll_host_commands(void);

#endif /* PLATYPUS_PROTO_FRAMER_H_ */
```

## src/radio_ble.c
```c
/*
 * Raw nRF52840 RADIO driver for promiscuous BLE capture.
 *
 * The nRF52840 radio has a native "Ble_1Mbit" hardware mode: it does the
 * preamble/access-address detection, de-whitening and CRC check for you,
 * the same silicon a normal BLE controller uses - we just don't run a BLE
 * controller/host on top of it. That's what turns this from "a BlueZ HCI
 * adapter" into something that behaves like Ubertooth: every valid PDU on
 * the tuned channel gets handed to us, addressed to us or not.
 */
#include "radio_ble.h"

#include <hal/nrf_radio.h>
#include <hal/nrf_timer.h>
#include <hal/nrf_ppi.h>
#include <zephyr/kernel.h>
#include <zephyr/irq.h>
#include <string.h>

/* RF channel index (0-39) -> physical BLE channel number -> frequency. */
static uint8_t rf_channel_to_ble_channel(uint8_t rf_chan)
{
    if (rf_chan == 37) return 37;
    if (rf_chan == 38) return 38;
    if (rf_chan == 39) return 39;
    /* Data channels 0-36 (RF index) map 1:1 to BLE data channel 0-36. */
    return rf_chan;
}

static uint32_t ble_channel_to_freq_mhz(uint8_t ble_chan)
{
    /* Per BT Core spec, Vol 6, Part B, 1.4.1. */
    if (ble_chan == 37) return 2402;
    if (ble_chan == 38) return 2426;
    if (ble_chan == 39) return 2480;
    if (ble_chan <= 10) return 2404 + (ble_chan * 2);
    return 2428 + ((ble_chan - 11) * 2);
}

/* Double-buffered PDU RX area the radio DMAs into. */
static uint8_t rx_buf[2][1 + BLE_MAX_PDU_LEN] __attribute__((aligned(4)));
static uint8_t rx_idx;

static ble_capture_cb_t user_cb;
static uint64_t timer1_base_us;

static void radio_ble_isr_entry(const void *arg);

int radio_ble_init(ble_capture_cb_t cb)
{
    user_cb = cb;

    /* TIMER1: free-running 1us tick, used purely as a capture clock so
     * every packet gets a timestamp - this is what the host tool uses to
     * reconstruct packet ordering/intervals in the pcap. */
    nrf_timer_mode_set(NRF_TIMER1, NRF_TIMER_MODE_TIMER);
    nrf_timer_bit_width_set(NRF_TIMER1, NRF_TIMER_BIT_WIDTH_32);
    nrf_timer_prescaler_set(NRF_TIMER1, NRF_TIMER_FREQ_1MHz);
    nrf_timer_task_trigger(NRF_TIMER1, NRF_TIMER_TASK_CLEAR);
    nrf_timer_task_trigger(NRF_TIMER1, NRF_TIMER_TASK_START);

    /* Radio power-up defaults; BLE mode + whitening/CRC are configured
     * per-channel in radio_ble_set_channel() because whitening & CRC
     * init depend on which channel / connection we're tuned to. */
    nrf_radio_power_set(NRF_RADIO, true);
    nrf_radio_mode_set(NRF_RADIO, NRF_RADIO_MODE_BLE_1MBIT);

    /* Packet layout matches the BLE LL PDU: 1-byte header (S0), 8-bit
     * length field, 0 extra bits, max payload BLE_MAX_PDU_LEN. */
    nrf_radio_packet_conf_t pcnf = {0};
    pcnf.lflen  = 8;
    pcnf.s0len  = 1;
    pcnf.s1len  = 0;
    pcnf.maxlen = BLE_MAX_PDU_LEN;
    pcnf.statlen = 0;
    pcnf.balen  = 3;      /* 3-byte base + 1-byte prefix = 4-byte AA */
    pcnf.big_endian = false;
    pcnf.whiteen = true;
    nrf_radio_packet_configure(NRF_RADIO, &pcnf);

    nrf_radio_crc_configure(NRF_RADIO, 3, NRF_RADIO_CRC_ADDR_SKIP,
                 0x00065B /* BLE CRC polynomial, init set per-channel */);

    IRQ_CONNECT(RADIO_IRQn, 0, radio_ble_isr_entry, NULL, 0);
    irq_enable(RADIO_IRQn);

    return 0;
}

int radio_ble_set_channel(uint8_t channel, uint32_t access_address,
               uint32_t crc_init)
{
    if (channel > 39) {
        return -EINVAL;
    }

    nrf_radio_task_trigger(NRF_RADIO, NRF_RADIO_TASK_DISABLE);

    uint8_t ble_chan = rf_channel_to_ble_channel(channel);
    uint32_t freq = ble_channel_to_freq_mhz(ble_chan);
    nrf_radio_frequency_set(NRF_RADIO, freq);

    /* Whitening uses the BLE data-whitening init value, which is the
     * channel index with the top bit set, per Core spec Vol 6 Part B 3.2. */
    nrf_radio_datawhiteiv_set(NRF_RADIO, ble_chan | 0x40);

    nrf_radio_base0_set(NRF_RADIO, (access_address << 8));
    nrf_radio_prefix0_set(NRF_RADIO, (access_address >> 24) & 0xFF);
    nrf_radio_rxaddresses_set(NRF_RADIO, 1 /* bit 0 = enable logical address 0 (BASE0+PREFIX0) */);

    nrf_radio_crcinit_set(NRF_RADIO, crc_init);

    nrf_radio_packetptr_set(NRF_RADIO, rx_buf[rx_idx]);

    nrf_radio_shorts_enable(NRF_RADIO,
        NRF_RADIO_SHORT_READY_START_MASK |
        NRF_RADIO_SHORT_END_START_MASK |
        NRF_RADIO_SHORT_ADDRESS_RSSISTART_MASK);

    nrf_radio_int_enable(NRF_RADIO, NRF_RADIO_INT_END_MASK);

    nrf_radio_task_trigger(NRF_RADIO, NRF_RADIO_TASK_RXEN);

    return 0;
}

void radio_ble_stop(void)
{
    nrf_radio_task_trigger(NRF_RADIO, NRF_RADIO_TASK_DISABLE);
}

/* RADIO ISR: fires on END (a packet, matching AA, fully received). */
static void radio_ble_isr_entry(const void *arg)
{
    ARG_UNUSED(arg);

    if (!nrf_radio_event_check(NRF_RADIO, NRF_RADIO_EVENT_END)) {
        return;
    }
    nrf_radio_event_clear(NRF_RADIO, NRF_RADIO_EVENT_END);

    uint8_t *buf = rx_buf[rx_idx];
    rx_idx ^= 1;
    nrf_radio_packetptr_set(NRF_RADIO, rx_buf[rx_idx]);

    struct ble_capture pkt = {0};
    pkt.crc_ok = nrf_radio_crc_status_check(NRF_RADIO);
    pkt.rssi_dbm = -(int8_t)nrf_radio_rssi_sample_get(NRF_RADIO);
    pkt.timestamp_us = timer1_base_us + nrf_timer_cc_get(NRF_TIMER1, 0);
    pkt.length = buf[1]; /* length byte (after S0/header byte) */
    if (pkt.length > BLE_MAX_PDU_LEN) {
        pkt.length = BLE_MAX_PDU_LEN;
    }
    memcpy(pkt.pdu, buf, pkt.length + 2);

    if (user_cb) {
        user_cb(&pkt);
    }
}
```

## src/radio_ble.h
```c
/*
 * Platypus Sniffer - raw nRF52840 RADIO peripheral driven in Bluetooth LE
 * PHY mode, used for promiscuous capture instead of Zephyr's BT controller.
 *
 * This is the same general approach used by well-known open BLE sniffer
 * projects on the nRF52 series (e.g. Sniffle, nRF Sniffer): put the
 * peripheral's hardware BLE mode to work directly so we see every packet
 * on a channel, not just packets addressed to us.
 */
#ifndef PLATYPUS_RADIO_BLE_H_
#define PLATYPUS_RADIO_BLE_H_

#include <stdint.h>
#include <stdbool.h>

#define BLE_MAX_PDU_LEN 255

/* One captured over-the-air packet, as handed up from the radio ISR. */
struct ble_capture {
    uint32_t access_address;
    uint8_t  channel;        /* 0-39 (RF channel index, not freq) */
    int8_t   rssi_dbm;
    uint32_t crc;
    bool     crc_ok;
    uint64_t timestamp_us;   /* since sniffer boot, from TIMER1 */
    uint8_t  length;
    uint8_t  pdu[BLE_MAX_PDU_LEN];
};

typedef void (*ble_capture_cb_t)(const struct ble_capture *pkt);

/* Bring up RADIO + TIMER1 (free-running capture clock) + PPI wiring. */
int radio_ble_init(ble_capture_cb_t cb);

/*
 * Tune to one of the 40 BLE RF channels (0-39) and start listening.
 * access_address / crc_init select what the hardware address-matches and
 * what CRC seed it de-whitens/validates against:
 *   - On advertising channels (37/38/39) always use the advertising
 *     access address 0x8E89BED6 and CRC init 0x555555.
 *   - When following a connection, pass the CONNECT_IND's AA and the
 *     3-byte CRCInit from the same PDU (see channel_hop.c).
 */
int radio_ble_set_channel(uint8_t channel, uint32_t access_address,
               uint32_t crc_init);

/* Stop receiving (radio to DISABLED state). */
void radio_ble_stop(void);

#endif /* PLATYPUS_RADIO_BLE_H_ */
```

## src/usb_transport.c
```c
/*
 * USB CDC-ACM transport, built against Zephyr's newer "USB device stack
 * next" (USBD) API rather than the older, now-deprecated USB device stack.
 *
 * This board's devicetree declares a single CDC-ACM UART node
 * (compatible = "zephyr,cdc-acm-uart"), and BOTH the legacy stack's class
 * driver and this newer stack's class driver bind to that same node by
 * default - trying to enable the legacy stack alongside this one fails the
 * link with "multiple definition of ...dts_ord...". So the legacy stack is
 * kept off (CONFIG_USB_DEVICE_STACK=n) and everything here goes through the
 * USBD_* APIs instead, following Zephyr's own samples/subsys/usb/cdc_acm
 * reference implementation.
 *
 * Despite the different init path, the actual byte I/O below
 * (uart_poll_out / uart_poll_in) is unchanged from a legacy-stack
 * implementation - both stacks' CDC-ACM class driver expose the same
 * standard Zephyr UART driver API for the resulting virtual UART device.
 */
#include "usb_transport.h"

#include <zephyr/kernel.h>
#include <zephyr/device.h>
#include <zephyr/drivers/uart.h>
#include <zephyr/usb/usbd.h>
#include <zephyr/logging/log.h>

LOG_MODULE_REGISTER(platypus_usb, LOG_LEVEL_INF);

static const struct device *cdc_dev = DEVICE_DT_GET_ONE(zephyr_cdc_acm_uart);

USBD_DEVICE_DEFINE(platypus_usbd,
                    DEVICE_DT_GET(DT_NODELABEL(zephyr_udc0)),
                    0x239A, 0x0002);

USBD_DESC_LANG_DEFINE(platypus_lang);
USBD_DESC_MANUFACTURER_DEFINE(platypus_mfr, "greatwhitek9-lab");
USBD_DESC_PRODUCT_DEFINE(platypus_product, "Platypus BLE Sniffer");

USBD_DESC_CONFIG_DEFINE(platypus_fs_cfg_desc, "FS Configuration");

/* Bus-powered, no remote wakeup - matches the bus-powered USB_MAX_POWER
 * budget this firmware targets for phone/tablet OTG power budgeting. */
static const uint8_t platypus_usbd_attributes = 0;

USBD_CONFIGURATION_DEFINE(platypus_fs_config, platypus_usbd_attributes, 96,
                           &platypus_fs_cfg_desc);

static K_SEM_DEFINE(dtr_sem, 0, 1);

static void platypus_fix_code_triple(struct usbd_context *uds_ctx,
                      const enum usbd_speed speed)
{
    if (IS_ENABLED(CONFIG_USBD_CDC_ACM_CLASS)) {
        /* CDC ACM has an Interface Association Descriptor - use the
         * triple that signals that instead of a bare single-interface
         * class code. */
        usbd_device_set_code_triple(uds_ctx, speed, USB_BCC_MISCELLANEOUS,
                         0x02, 0x01);
    } else {
        usbd_device_set_code_triple(uds_ctx, speed, 0, 0, 0);
    }
}

static void platypus_usbd_msg_cb(struct usbd_context *const ctx,
                   const struct usbd_msg *msg)
{
    if (usbd_can_detect_vbus(ctx)) {
        if (msg->type == USBD_MSG_VBUS_READY) {
            if (usbd_enable(ctx)) {
                LOG_ERR("Failed to enable USB device support");
            }
        }
        if (msg->type == USBD_MSG_VBUS_REMOVED) {
            if (usbd_disable(ctx)) {
                LOG_ERR("Failed to disable USB device support");
            }
        }
    }

    if (msg->type == USBD_MSG_CDC_ACM_CONTROL_LINE_STATE) {
        uint32_t dtr = 0U;

        uart_line_ctrl_get(msg->dev, UART_LINE_CTRL_DTR, &dtr);
        if (dtr) {
            k_sem_give(&dtr_sem);
        }
    }
}

static int platypus_usbd_setup(void)
{
    int err;

    err = usbd_add_descriptor(&platypus_usbd, &platypus_lang);
    if (err) {
        LOG_ERR("Failed to add language descriptor (%d)", err);
        return err;
    }
    err = usbd_add_descriptor(&platypus_usbd, &platypus_mfr);
    if (err) {
        LOG_ERR("Failed to add manufacturer descriptor (%d)", err);
        return err;
    }
    err = usbd_add_descriptor(&platypus_usbd, &platypus_product);
    if (err) {
        LOG_ERR("Failed to add product descriptor (%d)", err);
        return err;
    }

    err = usbd_add_configuration(&platypus_usbd, USBD_SPEED_FS,
                      &platypus_fs_config);
    if (err) {
        LOG_ERR("Failed to add Full-Speed configuration (%d)", err);
        return err;
    }

    err = usbd_register_all_classes(&platypus_usbd, USBD_SPEED_FS, 1, NULL);
    if (err) {
        LOG_ERR("Failed to register USB classes (%d)", err);
        return err;
    }

    platypus_fix_code_triple(&platypus_usbd, USBD_SPEED_FS);
    usbd_self_powered(&platypus_usbd,
               platypus_usbd_attributes & USB_SCD_SELF_POWERED);

    err = usbd_msg_register_cb(&platypus_usbd, platypus_usbd_msg_cb);
    if (err) {
        LOG_ERR("Failed to register USBD message callback (%d)", err);
        return err;
    }

    return 0;
}

int usb_transport_init(void)
{
    int err;

    if (!device_is_ready(cdc_dev)) {
        LOG_ERR("CDC ACM device not ready");
        return -ENODEV;
    }

    err = platypus_usbd_setup();
    if (err) {
        return err;
    }

    err = usbd_init(&platypus_usbd);
    if (err) {
        LOG_ERR("Failed to initialize USB device support (%d)", err);
        return err;
    }

    if (!usbd_can_detect_vbus(&platypus_usbd)) {
        err = usbd_enable(&platypus_usbd);
        if (err) {
            LOG_ERR("Failed to enable USB device support (%d)", err);
            return err;
        }
    }

    /* Block until the host (desktop tool, Wireshark extcap, or the
     * Android app) actually opens the serial port, same as the previous
     * legacy-stack implementation did via a DTR poll loop - this version
     * just reacts to the USBD control-line-state message instead of
     * busy-polling. */
    k_sem_take(&dtr_sem, K_FOREVER);

    return 0;
}

void usb_transport_write(const uint8_t *data, size_t len)
{
    if (!cdc_dev) {
        return;
    }
    for (size_t i = 0; i < len; i++) {
        uart_poll_out(cdc_dev, data[i]);
    }
}

bool usb_transport_read_cmd_byte(uint8_t *out)
{
    if (!cdc_dev) {
        return false;
    }
    return uart_poll_in(cdc_dev, out) == 0;
}
```

## src/usb_transport.h
```c
#ifndef PLATYPUS_USB_TRANSPORT_H_
#define PLATYPUS_USB_TRANSPORT_H_

#include <stdint.h>
#include <stdbool.h>
#include <stddef.h>

/* Thin wrapper over the Zephyr USB CDC-ACM device so the rest of the
 * firmware never touches Zephyr UART APIs directly. */
int usb_transport_init(void);
void usb_transport_write(const uint8_t *data, size_t len);
bool usb_transport_read_cmd_byte(uint8_t *out);

#endif /* PLATYPUS_USB_TRANSPORT_H_ */
```
