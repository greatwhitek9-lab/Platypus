## build/platypus-heltec-t114-hci-usb-base/Kconfig/arch/Kconfig
```kconfig
# Load Zephyr Arch Kconfig descriptions.
osource "/home/urbanpoacher/ble-dongle-build/zephyrproject/zephyr/arch/rx/Kconfig"
osource "/home/urbanpoacher/ble-dongle-build/zephyrproject/zephyr/arch/x86/Kconfig"
osource "/home/urbanpoacher/ble-dongle-build/zephyrproject/zephyr/arch/xtensa/Kconfig"
osource "/home/urbanpoacher/ble-dongle-build/zephyrproject/zephyr/arch/sparc/Kconfig"
osource "/home/urbanpoacher/ble-dongle-build/zephyrproject/zephyr/arch/riscv/Kconfig"
osource "/home/urbanpoacher/ble-dongle-build/zephyrproject/zephyr/arch/posix/Kconfig"
osource "/home/urbanpoacher/ble-dongle-build/zephyrproject/zephyr/arch/openrisc/Kconfig"
osource "/home/urbanpoacher/ble-dongle-build/zephyrproject/zephyr/arch/mips/Kconfig"
osource "/home/urbanpoacher/ble-dongle-build/zephyrproject/zephyr/arch/arm64/Kconfig"
osource "/home/urbanpoacher/ble-dongle-build/zephyrproject/zephyr/arch/arm/Kconfig"
osource "/home/urbanpoacher/ble-dongle-build/zephyrproject/zephyr/arch/arc/Kconfig"
```

## build/platypus-heltec-t114-hci-usb-base/Kconfig/boards/Kconfig.defconfig
```kconfig
# Load Zephyr board defconfig descriptions.
osource "/home/urbanpoacher/ble-dongle-build/zephyrproject/zephyr/boards/heltec/heltec_t114_v2/Kconfig.defconfig"
```

## build/platypus-heltec-t114-hci-usb/Kconfig/boards/Kconfig.heltec_t114_v2
```kconfig
# Load board Kconfig descriptions.
osource "/home/urbanpoacher/ble-dongle-build/zephyrproject/zephyr/boards/heltec/heltec_t114_v2/Kconfig.heltec_t114_v2"
```
